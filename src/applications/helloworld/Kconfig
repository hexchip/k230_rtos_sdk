## src/applications/helloworld/Kconfig
```kconfig
menuconfig APP_ENABLE_HELLOWORLD
    bool "Enable USB TTY"
    default y

    if APP_ENABLE_HELLOWORLD
        choice TERMINAL_FONT
            prompt "Choice Terminal font"
            default TERMINAL_FONT_UNSCII_16

            config TERMINAL_FONT_UNSCII_8
                bool "UNSCII_8"

            config TERMINAL_FONT_UNSCII_16
                bool "UNSCII_16"
        endchoice
    endif
    
```
